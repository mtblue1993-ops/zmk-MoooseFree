#include "MoooseFree.dtsi"

right_encoder: encoder_right {
    compatible = "alps,ec11";
    a-gpios = <&gpio0 10 (GPIO_ACTIVE_HIGH | GPIO_PULL_UP)>;
    b-gpios = <&gpio0 9 (GPIO_ACTIVE_HIGH | GPIO_PULL_UP)>;
    steps = <24>;
    status = "disabled";
};

sensors_right: keymap_sensors_right {
    compatible = "zmk,keymap-sensors";
    sensors = <&right_encoder>;
    triggers-per-rotation = <24>;
};

&left_encoder {
    status = "okay";
};



/ {
    trackball: trackball {
        status = "disabled";
    };

    aliases {
        led-red = &led0;
        led-green = &led1;
        led-blue = &led2;
    };

    leds {
        compatible = "gpio-leds";
        status = "okay";
        led0: led_0 {
            gpios = <&gpio0 26 GPIO_ACTIVE_LOW>;  // red LED, connected to P0.26
        };
        led1: led_1 {
            gpios = <&gpio0 30 GPIO_ACTIVE_LOW>;  // green LED, connected to P0.30
        };
        led2: led_2 {
            gpios = <&gpio0 6 GPIO_ACTIVE_LOW>;  // blue LED, connected to P0.06
        };
    };
};